## Kconfig.projbuild
```kconfig
menu "Privacy Shield Configuration"

    # =================================================================
    #  Build Mode
    # =================================================================
    choice PRIVACY_SHIELD_BUILD_MODE
        prompt "Build mode"
        default PRIVACY_SHIELD_BUILD_DEBUG
        help
            Debug mode = raw audio dump + verbose logs.
            Production mode = DSP pipeline + info-level logs only.

        config PRIVACY_SHIELD_BUILD_DEBUG
            bool "Debug (raw audio + verbose logs)"
        config PRIVACY_SHIELD_BUILD_PRODUCTION
            bool "Production (DSP pipeline + quiet logs)"
    endchoice

    # Legacy alias — still used by i2s_mic.c
    config PRIVACY_SHIELD_DEBUG_MODE
        bool
        default y if PRIVACY_SHIELD_BUILD_DEBUG
        default n if PRIVACY_SHIELD_BUILD_PRODUCTION

    # =================================================================
    #  Global Log Level (sets the maximum compiled-in log detail)
    # =================================================================
    choice PRIVACY_SHIELD_LOG_LEVEL
        prompt "Maximum log level compiled in"
        default PRIVACY_SHIELD_LOG_DEBUG
        help
            Controls the maximum verbosity compiled into the firmware.
            Messages above this level are stripped from the binary.
            Runtime log levels can still be lowered (made quieter),
            but never raised above this compile-time cap.

        config PRIVACY_SHIELD_LOG_ERROR
            bool "Error only"
        config PRIVACY_SHIELD_LOG_WARN
            bool "Warning + Error"
        config PRIVACY_SHIELD_LOG_INFO
            bool "Info + Warning + Error (recommended for production)"
        config PRIVACY_SHIELD_LOG_DEBUG
            bool "Debug + everything (recommended for development)"
        config PRIVACY_SHIELD_LOG_VERBOSE
            bool "Verbose + everything"
    endchoice

    # =================================================================
    #  Per-Subsystem Log Toggles (runtime log level overrides)
    # =================================================================
    menu "Subsystem Log Levels"

        config PRIVACY_SHIELD_LOG_MESH
            bool "Mesh log level: Debug"
            default y if PRIVACY_SHIELD_BUILD_DEBUG
            help
                When enabled, mesh_core and discovery tags log at DEBUG level.
                Shows HELLO broadcasts, neighbor table changes, send failures.

        config PRIVACY_SHIELD_LOG_AUDIO
            bool "Audio log level: Debug"
            default y if PRIVACY_SHIELD_BUILD_DEBUG
            help
                When enabled, audio_hal and mic tags log at DEBUG level.
                Shows calibration details, buffer reads, sample counts.

    endmenu

endmenu
```

## sdkconfig.defaults
```kconfig
# Set the correct microcontroller target
CONFIG_IDF_TARGET="esp32s3"

# Maximize CPU frequency (240MHz) for heavy audio processing
CONFIG_ESP_DEFAULT_CPU_FREQ_MHZ_240=y

# Enable external memory (8MB PSRAM)
CONFIG_SPIRAM=y
CONFIG_SPIRAM_FETCH_INSTRUCTIONS=y
CONFIG_SPIRAM_RODATA=y

# Set FreeRTOS tick rate to 1000Hz (1 tick = 1ms) to handle audio without delays
CONFIG_FREERTOS_HZ=1000

# ---- Privacy Shield Configuration ----
# Build mode: debug (raw audio + verbose logs)
CONFIG_PRIVACY_SHIELD_BUILD_DEBUG=y

# Logging: compile in all levels, default to debug
CONFIG_LOG_DEFAULT_LEVEL_DEBUG=y
CONFIG_LOG_MAXIMUM_LEVEL_DEBUG=y

# Per-subsystem debug logging (enabled by default in debug builds)
CONFIG_PRIVACY_SHIELD_LOG_MESH=y
CONFIG_PRIVACY_SHIELD_LOG_AUDIO=y
```
